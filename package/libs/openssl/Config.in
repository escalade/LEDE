## package/libs/openssl/Config.in
```kconfig
if PACKAGE_libopenssl

config OPENSSL_WITH_EC
	bool
	default y
	prompt "Enable elliptic curve support"

config OPENSSL_WITH_EC2M
        bool
        depends on OPENSSL_WITH_EC
        prompt "Enable ec2m support"

config OPENSSL_WITH_DEPRECATED
	bool
	default y
	prompt "Include deprecated APIs (See help for a list of packages that need this)"
	help
		Since openssl 1.1.0 is not supported yet, packages requiring this
		option do not list it as a requirement.
		Packages requiring this right now:  hostapd, freeswitch-stable, freeswitch,
		python, python3, squid.

config OPENSSL_WITH_DTLS
	bool
	default n
	prompt "Enable DTLS support"

config OPENSSL_WITH_COMPRESSION
	bool
	default n
	prompt "Enable compression support"

config OPENSSL_WITH_PSK
	bool
	default y
	prompt "Enable PSK support"

config OPENSSL_WITH_SRP
	bool
	default y
	prompt "Enable SRP support"

config OPENSSL_OPTIMIZE_SPEED
	bool
	default y if x86_64 || i386
	prompt "Enable optimization for speed instead of size"
	select OPENSSL_WITH_ASM
	help
		Enabling this option increases code size (around 20%) and
		performance.  The increase in performance and size depends
		on the target CPU. EC and AES seem to benefit the most,
		with EC speed increased by 20%-50% (mipsel & x86).
		AES-GCM is supposed to be 3x faster on x86. YMMV.

config OPENSSL_WITH_ASM
	bool
	default y
	prompt "Compile with optimized assembly code"
	depends on !arc
	help
		Disabling this option will reduce code size and performance.
		The increase in performance and size depends on the target
		CPU and on the algorithms being optimized.  As of 1.1.0i*:

		Platform  Pkg Inc. Algorithms where assembly is used - ~% Speed Increase
		aarch64   174K     BN, aes, sha1, sha256, sha512, nist256, poly1305
		arm       152K     BN, aes, sha1, sha256, sha512, nist256, poly1305
		i386      183K     BN+147%, aes+300%, rc4+55%, sha1+160%, sha256+114%, sha512+270%, nist256+282%, poly1305+292%
		mipsel      1.5K   BN+97%, aes+4%, sha1+94%, sha256+60%
		mips64	    3.7K   BN, aes, sha1, sha256, sha512, poly1305
		powerpc    20K     BN, aes, sha1, sha256, sha512, poly1305
		x86_64    228K     BN+220%, aes+173%, rc4+38%, sha1+40%, sha256+64%, sha512+31%, nist256+354%, poly1305+228%

		* Only most common algorithms shown. Your mileage may vary.
		  BN (bignum) performance was measured using RSA sign/verify.

config OPENSSL_NO_SSE2
	bool
	default y if TARGET_x86_legacy || TARGET_x86_geode
	prompt "Disable use of x86 SSE2 instructions"
	help
		Use of SSE2 instructions greatly increase performance (up to 3x faster)
		with a minimum (~0.2%, or 23KB) increase in package size, but it will
		bring no benefit if your hardware does not support them, such as Geode
		GX and LX.  In this case you may save 23KB by saying yes here.
		AMD Geode NX, and Intel Pentium 4 and above support SSE2.
	depends on OPENSSL_WITH_ASM && i386

config OPENSSL_ENGINE
	bool "Enable engine support"
	help
		This enables alternative cryptography implementations,
		most commonly for interfacing with external crypto devices,
		or supporting new/alternative ciphers and digests.

config OPENSSL_ENGINE_DIGEST
	bool
	depends on OPENSSL_ENGINE_CRYPTO
	prompt "Digest acceleration support"

endif

config OPENSSL_ENGINE_CRYPTO
	bool
	select OPENSSL_ENGINE
	prompt "Acceleration support through /dev/crypto" if PACKAGE_libopenssl
```
